## config/west.yml
```yaml
manifest:
  remotes:
    - name: zmkfirmware
      url-base: https://github.com/zmkfirmware
    - name: zmk-locales
      url-base: https://github.com/joelspadin
  projects:
    - name: zmk
      remote: zmkfirmware
      revision: main
      import: app/west.yml
#    - name: zmk-locales
#      remote: zmk-locales
#      revision: https://github.com/joelspadin/zmk-locales
#      import: west.yml
  self:
    path: config
```
